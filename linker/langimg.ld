SECTIONS
{
    HIDDEN(__romPos = 0);
    _gp = 0x800C46F0;
    header_ROM_START = __romPos;
    header_VRAM = ADDR(.header);
    .header : AT(header_ROM_START) SUBALIGN(4)
    {
        FILL(0x00000000);
        header_DATA_START = .;
        build/langimg/assets/langimg/header.o(.data);
        header_DATA_END = .;
        header_DATA_SIZE = ABSOLUTE(header_DATA_END - header_DATA_START);
    }
    __romPos += SIZEOF(.header);
    header_ROM_END = __romPos;
    header_VRAM_END = .;

    main_ROM_START = __romPos;
    main_VRAM = ADDR(.main);
    .main 0x80011800 : AT(main_ROM_START) SUBALIGN(4)
    {
        FILL(0x00000000);
        main_TEXT_START = .;
        build/langimg/asm/langimg/data/text_table.o(.text);
        build/langimg/lib/sound/langimg/chunk_00.o(.text);
        build/langimg/lib/sound/langimg/chunk_01.o(.text);
        build/langimg/lib/cdaudio/langimg/chunk_01b.o(.text);
        build/langimg/src/langimg/chunk_02.o(.text);
        build/langimg/src/langimg/chunk_03.o(.text);
        build/langimg/src/langimg/chunk_04.o(.text);
        build/langimg/src/langimg/chunk_05.o(.text);
        build/langimg/src/langimg/chunk_06.o(.text);
        build/langimg/src/langimg/chunk_07.o(.text);
        build/langimg/src/langimg/chunk_08.o(.text);
        build/langimg/src/langimg/chunk_09.o(.text);
        build/langimg/src/langimg/chunk_10.o(.text);
        build/langimg/src/langimg/chunk_11.o(.text);
        build/langimg/src/langimg/chunk_12.o(.text);
        build/langimg/src/langimg/chunk_13.o(.text);
        build/langimg/src/langimg/chunk_14.o(.text);
        build/langimg/src/langimg/chunk_15.o(.text);
        build/langimg/src/langimg/chunk_16.o(.text);
        build/langimg/src/langimg/chunk_17.o(.text);
        build/langimg/src/langimg/chunk_18.o(.text);
        build/langimg/src/langimg/chunk_19.o(.text);
        build/langimg/src/langimg/chunk_20.o(.text);
        build/langimg/src/langimg/chunk_21.o(.text);
        build/langimg/src/langimg/chunk_22.o(.text);
        build/langimg/src/langimg/chunk_23.o(.text);
        build/langimg/src/langimg/chunk_24.o(.text);
        build/langimg/src/langimg/chunk_25.o(.text);
        build/langimg/src/langimg/chunk_26.o(.text);
        build/langimg/src/langimg/chunk_27.o(.text);
        build/langimg/src/langimg/chunk_28.o(.text);
        build/langimg/src/langimg/chunk_29.o(.text);
        build/langimg/src/langimg/chunk_30.o(.text);
        build/langimg/src/langimg/chunk_31.o(.text);
        build/langimg/src/langimg/chunk_32.o(.text);
        build/langimg/src/langimg/chunk_33.o(.text);
        build/langimg/src/langimg/chunk_34.o(.text);
        build/langimg/src/langimg/chunk_35.o(.text);
        build/langimg/src/langimg/chunk_36.o(.text);
        build/langimg/src/langimg/chunk_37.o(.text);
        build/langimg/src/langimg/chunk_38.o(.text);
        build/langimg/src/langimg/chunk_39.o(.text);
        build/langimg/src/langimg/chunk_40.o(.text);
        build/langimg/src/langimg/chunk_41.o(.text);
        build/langimg/src/langimg/chunk_42.o(.text);
        build/langimg/src/langimg/chunk_43.o(.text);
        build/langimg/src/langimg/chunk_44.o(.text);
        build/langimg/src/langimg/chunk_45.o(.text);
        build/langimg/src/langimg/chunk_46.o(.text);
        build/langimg/src/langimg/chunk_47.o(.text);
        build/langimg/src/langimg/chunk_48.o(.text);
        build/langimg/src/langimg/chunk_49.o(.text);
        build/langimg/src/langimg/chunk_50.o(.text);
        build/langimg/src/langimg/chunk_51.o(.text);
        build/langimg/src/langimg/chunk_52.o(.text);
        build/langimg/src/langimg/chunk_53.o(.text);
        build/langimg/src/langimg/chunk_54.o(.text);
        build/langimg/src/langimg/chunk_55.o(.text);
        build/langimg/src/langimg/chunk_56.o(.text);
        build/langimg/src/langimg/chunk_57.o(.text);
        build/langimg/src/langimg/chunk_58.o(.text);
        build/langimg/src/langimg/chunk_59.o(.text);
        build/langimg/src/langimg/chunk_60.o(.text);
        build/langimg/src/langimg/chunk_61.o(.text);
        build/langimg/src/langimg/chunk_62.o(.text);
        build/langimg/src/langimg/chunk_63.o(.text);
        build/langimg/src/langimg/chunk_64.o(.text);
        build/langimg/src/langimg/chunk_65.o(.text);
        build/langimg/src/langimg/chunk_66.o(.text);
        build/langimg/src/langimg/chunk_67.o(.text);
        build/langimg/src/langimg/chunk_68.o(.text);
        build/langimg/src/langimg/chunk_69.o(.text);
        build/langimg/src/langimg/chunk_70.o(.text);
        build/langimg/src/langimg/chunk_71.o(.text);
        build/langimg/src/langimg/chunk_72.o(.text);
        build/langimg/src/langimg/chunk_73.o(.text);
        build/langimg/src/langimg/chunk_74.o(.text);
        build/langimg/lib/psyq/langimg/lib_00.o(.text);
        build/langimg/lib/psyq/langimg/lib_01.o(.text);
        build/langimg/lib/psyq/langimg/lib_02.o(.text);
        build/langimg/lib/psyq/langimg/lib_03.o(.text);
        build/langimg/lib/psyq/langimg/lib_04.o(.text);
        build/langimg/lib/psyq/langimg/lib_05.o(.text);
        build/langimg/lib/psyq/langimg/lib_06.o(.text);
        build/langimg/lib/psyq/langimg/lib_07.o(.text);
        main_TEXT_END = .;
        main_TEXT_SIZE = ABSOLUTE(main_TEXT_END - main_TEXT_START);
        main_RODATA_START = .;
        build/langimg/asm/langimg/data/text_table.o(.rodata);
        build/langimg/lib/sound/langimg/chunk_00.o(.rodata);
        build/langimg/lib/sound/langimg/chunk_01.o(.rodata);
        build/langimg/asm/langimg/data/ctors.rodata.o(.rodata);
        build/langimg/lib/cdaudio/langimg/chunk_01b.o(.rodata);
        build/langimg/src/langimg/chunk_02.o(.rodata);
        build/langimg/src/langimg/chunk_03.o(.rodata);
        build/langimg/src/langimg/chunk_04.o(.rodata);
        build/langimg/src/langimg/chunk_05.o(.rodata);
        build/langimg/src/langimg/chunk_06.o(.rodata);
        build/langimg/src/langimg/chunk_07.o(.rodata);
        build/langimg/src/langimg/chunk_08.o(.rodata);
        build/langimg/src/langimg/chunk_09.o(.rodata);
        build/langimg/src/langimg/chunk_10.o(.rodata);
        build/langimg/src/langimg/chunk_11.o(.rodata);
        build/langimg/src/langimg/chunk_12.o(.rodata);
        build/langimg/src/langimg/chunk_13.o(.rodata);
        build/langimg/src/langimg/chunk_14.o(.rodata);
        build/langimg/src/langimg/chunk_15.o(.rodata);
        build/langimg/src/langimg/chunk_16.o(.rodata);
        build/langimg/src/langimg/chunk_17.o(.rodata);
        build/langimg/src/langimg/chunk_18.o(.rodata);
        build/langimg/src/langimg/chunk_19.o(.rodata);
        build/langimg/src/langimg/chunk_20.o(.rodata);
        build/langimg/src/langimg/chunk_21.o(.rodata);
        build/langimg/src/langimg/chunk_22.o(.rodata);
        build/langimg/src/langimg/chunk_23.o(.rodata);
        build/langimg/src/langimg/chunk_24.o(.rodata);
        build/langimg/src/langimg/chunk_25.o(.rodata);
        build/langimg/src/langimg/chunk_26.o(.rodata);
        build/langimg/src/langimg/chunk_27.o(.rodata);
        build/langimg/src/langimg/chunk_28.o(.rodata);
        build/langimg/src/langimg/chunk_29.o(.rodata);
        build/langimg/src/langimg/chunk_30.o(.rodata);
        build/langimg/src/langimg/chunk_31.o(.rodata);
        build/langimg/src/langimg/chunk_32.o(.rodata);
        build/langimg/src/langimg/chunk_33.o(.rodata);
        build/langimg/src/langimg/chunk_34.o(.rodata);
        build/langimg/src/langimg/chunk_35.o(.rodata);
        build/langimg/src/langimg/chunk_36.o(.rodata);
        build/langimg/src/langimg/chunk_37.o(.rodata);
        build/langimg/src/langimg/chunk_38.o(.rodata);
        build/langimg/src/langimg/chunk_39.o(.rodata);
        build/langimg/src/langimg/chunk_40.o(.rodata);
        build/langimg/src/langimg/chunk_41.o(.rodata);
        build/langimg/src/langimg/chunk_42.o(.rodata);
        build/langimg/src/langimg/chunk_43.o(.rodata);
        build/langimg/src/langimg/chunk_44.o(.rodata);
        build/langimg/src/langimg/chunk_45.o(.rodata);
        build/langimg/src/langimg/chunk_46.o(.rodata);
        build/langimg/src/langimg/chunk_47.o(.rodata);
        build/langimg/src/langimg/chunk_48.o(.rodata);
        build/langimg/src/langimg/chunk_49.o(.rodata);
        build/langimg/src/langimg/chunk_50.o(.rodata);
        build/langimg/src/langimg/chunk_51.o(.rodata);
        build/langimg/src/langimg/chunk_52.o(.rodata);
        build/langimg/src/langimg/chunk_53.o(.rodata);
        build/langimg/src/langimg/chunk_54.o(.rodata);
        build/langimg/src/langimg/chunk_55.o(.rodata);
        build/langimg/src/langimg/chunk_56.o(.rodata);
        build/langimg/src/langimg/chunk_57.o(.rodata);
        build/langimg/src/langimg/chunk_58.o(.rodata);
        build/langimg/src/langimg/chunk_59.o(.rodata);
        build/langimg/src/langimg/chunk_60.o(.rodata);
        build/langimg/src/langimg/chunk_61.o(.rodata);
        build/langimg/src/langimg/chunk_62.o(.rodata);
        build/langimg/src/langimg/chunk_63.o(.rodata);
        build/langimg/src/langimg/chunk_64.o(.rodata);
        build/langimg/src/langimg/chunk_65.o(.rodata);
        build/langimg/src/langimg/chunk_66.o(.rodata);
        build/langimg/src/langimg/chunk_67.o(.rodata);
        build/langimg/src/langimg/chunk_68.o(.rodata);
        build/langimg/src/langimg/chunk_69.o(.rodata);
        build/langimg/src/langimg/chunk_70.o(.rodata);
        build/langimg/src/langimg/chunk_71.o(.rodata);
        build/langimg/src/langimg/chunk_72.o(.rodata);
        build/langimg/src/langimg/chunk_73.o(.rodata);
        build/langimg/src/langimg/chunk_74.o(.rodata);
        build/langimg/lib/psyq/langimg/lib_00.o(.rodata);
        build/langimg/lib/psyq/langimg/lib_01.o(.rodata);
        build/langimg/lib/psyq/langimg/lib_02.o(.rodata);
        build/langimg/lib/psyq/langimg/lib_03.o(.rodata);
        build/langimg/lib/psyq/langimg/lib_04.o(.rodata);
        build/langimg/lib/psyq/langimg/lib_05.o(.rodata);
        build/langimg/lib/psyq/langimg/lib_06.o(.rodata);
        build/langimg/lib/psyq/langimg/lib_07.o(.rodata);
        main_RODATA_END = .;
        main_RODATA_SIZE = ABSOLUTE(main_RODATA_END - main_RODATA_START);
        main_DATA_START = .;
        build/langimg/asm/langimg/data/text_table.o(.data);
        build/langimg/lib/sound/langimg/chunk_00.o(.data);
        build/langimg/lib/sound/langimg/chunk_01.o(.data);
        build/langimg/lib/cdaudio/langimg/chunk_01b.o(.data);
        build/langimg/src/langimg/chunk_02.o(.data);
        build/langimg/src/langimg/chunk_03.o(.data);
        build/langimg/src/langimg/chunk_04.o(.data);
        build/langimg/src/langimg/chunk_05.o(.data);
        build/langimg/src/langimg/chunk_06.o(.data);
        build/langimg/src/langimg/chunk_07.o(.data);
        build/langimg/src/langimg/chunk_08.o(.data);
        build/langimg/src/langimg/chunk_09.o(.data);
        build/langimg/src/langimg/chunk_10.o(.data);
        build/langimg/src/langimg/chunk_11.o(.data);
        build/langimg/src/langimg/chunk_12.o(.data);
        build/langimg/src/langimg/chunk_13.o(.data);
        build/langimg/src/langimg/chunk_14.o(.data);
        build/langimg/src/langimg/chunk_15.o(.data);
        build/langimg/src/langimg/chunk_16.o(.data);
        build/langimg/src/langimg/chunk_17.o(.data);
        build/langimg/src/langimg/chunk_18.o(.data);
        build/langimg/src/langimg/chunk_19.o(.data);
        build/langimg/src/langimg/chunk_20.o(.data);
        build/langimg/src/langimg/chunk_21.o(.data);
        build/langimg/src/langimg/chunk_22.o(.data);
        build/langimg/src/langimg/chunk_23.o(.data);
        build/langimg/src/langimg/chunk_24.o(.data);
        build/langimg/src/langimg/chunk_25.o(.data);
        build/langimg/src/langimg/chunk_26.o(.data);
        build/langimg/src/langimg/chunk_27.o(.data);
        build/langimg/src/langimg/chunk_28.o(.data);
        build/langimg/src/langimg/chunk_29.o(.data);
        build/langimg/src/langimg/chunk_30.o(.data);
        build/langimg/src/langimg/chunk_31.o(.data);
        build/langimg/src/langimg/chunk_32.o(.data);
        build/langimg/src/langimg/chunk_33.o(.data);
        build/langimg/src/langimg/chunk_34.o(.data);
        build/langimg/src/langimg/chunk_35.o(.data);
        build/langimg/src/langimg/chunk_36.o(.data);
        build/langimg/src/langimg/chunk_37.o(.data);
        build/langimg/src/langimg/chunk_38.o(.data);
        build/langimg/src/langimg/chunk_39.o(.data);
        build/langimg/src/langimg/chunk_40.o(.data);
        build/langimg/src/langimg/chunk_41.o(.data);
        build/langimg/src/langimg/chunk_42.o(.data);
        build/langimg/src/langimg/chunk_43.o(.data);
        build/langimg/src/langimg/chunk_44.o(.data);
        build/langimg/src/langimg/chunk_45.o(.data);
        build/langimg/src/langimg/chunk_46.o(.data);
        build/langimg/src/langimg/chunk_47.o(.data);
        build/langimg/src/langimg/chunk_48.o(.data);
        build/langimg/src/langimg/chunk_49.o(.data);
        build/langimg/src/langimg/chunk_50.o(.data);
        build/langimg/src/langimg/chunk_51.o(.data);
        build/langimg/src/langimg/chunk_52.o(.data);
        build/langimg/src/langimg/chunk_53.o(.data);
        build/langimg/src/langimg/chunk_54.o(.data);
        build/langimg/src/langimg/chunk_55.o(.data);
        build/langimg/src/langimg/chunk_56.o(.data);
        build/langimg/src/langimg/chunk_57.o(.data);
        build/langimg/src/langimg/chunk_58.o(.data);
        build/langimg/src/langimg/chunk_59.o(.data);
        build/langimg/src/langimg/chunk_60.o(.data);
        build/langimg/src/langimg/chunk_61.o(.data);
        build/langimg/src/langimg/chunk_62.o(.data);
        build/langimg/src/langimg/chunk_63.o(.data);
        build/langimg/src/langimg/chunk_64.o(.data);
        build/langimg/src/langimg/chunk_65.o(.data);
        build/langimg/src/langimg/chunk_66.o(.data);
        build/langimg/src/langimg/chunk_67.o(.data);
        build/langimg/src/langimg/chunk_68.o(.data);
        build/langimg/src/langimg/chunk_69.o(.data);
        build/langimg/src/langimg/chunk_70.o(.data);
        build/langimg/src/langimg/chunk_71.o(.data);
        build/langimg/src/langimg/chunk_72.o(.data);
        build/langimg/src/langimg/chunk_73.o(.data);
        build/langimg/src/langimg/chunk_74.o(.data);
        build/langimg/lib/psyq/langimg/lib_00.o(.data);
        build/langimg/lib/psyq/langimg/lib_01.o(.data);
        build/langimg/lib/psyq/langimg/lib_02.o(.data);
        build/langimg/lib/psyq/langimg/lib_03.o(.data);
        build/langimg/lib/psyq/langimg/lib_04.o(.data);
        build/langimg/lib/psyq/langimg/lib_05.o(.data);
        build/langimg/lib/psyq/langimg/lib_06.o(.data);
        build/langimg/lib/psyq/langimg/lib_07.o(.data);
        build/langimg/asm/langimg/data/data.data.o(.data);
        build/langimg/asm/langimg/data/sdata.data.o(.data);
        main_DATA_END = .;
        main_DATA_SIZE = ABSOLUTE(main_DATA_END - main_DATA_START);
    }
    main_bss_VRAM = ADDR(.main_bss);
    .main_bss (NOLOAD) : SUBALIGN(4)
    {
        FILL(0x00000000);
        main_BSS_START = .;
        build/langimg/asm/langimg/data/text_table.o(.bss);
        build/langimg/lib/sound/langimg/chunk_00.o(.bss);
        build/langimg/lib/sound/langimg/chunk_01.o(.bss);
        build/langimg/lib/cdaudio/langimg/chunk_01b.o(.bss);
        build/langimg/src/langimg/chunk_02.o(.bss);
        build/langimg/src/langimg/chunk_03.o(.bss);
        build/langimg/src/langimg/chunk_04.o(.bss);
        build/langimg/src/langimg/chunk_05.o(.bss);
        build/langimg/src/langimg/chunk_06.o(.bss);
        build/langimg/src/langimg/chunk_07.o(.bss);
        build/langimg/src/langimg/chunk_08.o(.bss);
        build/langimg/src/langimg/chunk_09.o(.bss);
        build/langimg/src/langimg/chunk_10.o(.bss);
        build/langimg/src/langimg/chunk_11.o(.bss);
        build/langimg/src/langimg/chunk_12.o(.bss);
        build/langimg/src/langimg/chunk_13.o(.bss);
        build/langimg/src/langimg/chunk_14.o(.bss);
        build/langimg/src/langimg/chunk_15.o(.bss);
        build/langimg/src/langimg/chunk_16.o(.bss);
        build/langimg/src/langimg/chunk_17.o(.bss);
        build/langimg/src/langimg/chunk_18.o(.bss);
        build/langimg/src/langimg/chunk_19.o(.bss);
        build/langimg/src/langimg/chunk_20.o(.bss);
        build/langimg/src/langimg/chunk_21.o(.bss);
        build/langimg/src/langimg/chunk_22.o(.bss);
        build/langimg/src/langimg/chunk_23.o(.bss);
        build/langimg/src/langimg/chunk_24.o(.bss);
        build/langimg/src/langimg/chunk_25.o(.bss);
        build/langimg/src/langimg/chunk_26.o(.bss);
        build/langimg/src/langimg/chunk_27.o(.bss);
        build/langimg/src/langimg/chunk_28.o(.bss);
        build/langimg/src/langimg/chunk_29.o(.bss);
        build/langimg/src/langimg/chunk_30.o(.bss);
        build/langimg/src/langimg/chunk_31.o(.bss);
        build/langimg/src/langimg/chunk_32.o(.bss);
        build/langimg/src/langimg/chunk_33.o(.bss);
        build/langimg/src/langimg/chunk_34.o(.bss);
        build/langimg/src/langimg/chunk_35.o(.bss);
        build/langimg/src/langimg/chunk_36.o(.bss);
        build/langimg/src/langimg/chunk_37.o(.bss);
        build/langimg/src/langimg/chunk_38.o(.bss);
        build/langimg/src/langimg/chunk_39.o(.bss);
        build/langimg/src/langimg/chunk_40.o(.bss);
        build/langimg/src/langimg/chunk_41.o(.bss);
        build/langimg/src/langimg/chunk_42.o(.bss);
        build/langimg/src/langimg/chunk_43.o(.bss);
        build/langimg/src/langimg/chunk_44.o(.bss);
        build/langimg/src/langimg/chunk_45.o(.bss);
        build/langimg/src/langimg/chunk_46.o(.bss);
        build/langimg/src/langimg/chunk_47.o(.bss);
        build/langimg/src/langimg/chunk_48.o(.bss);
        build/langimg/src/langimg/chunk_49.o(.bss);
        build/langimg/src/langimg/chunk_50.o(.bss);
        build/langimg/src/langimg/chunk_51.o(.bss);
        build/langimg/src/langimg/chunk_52.o(.bss);
        build/langimg/src/langimg/chunk_53.o(.bss);
        build/langimg/src/langimg/chunk_54.o(.bss);
        build/langimg/src/langimg/chunk_55.o(.bss);
        build/langimg/src/langimg/chunk_56.o(.bss);
        build/langimg/src/langimg/chunk_57.o(.bss);
        build/langimg/src/langimg/chunk_58.o(.bss);
        build/langimg/src/langimg/chunk_59.o(.bss);
        build/langimg/src/langimg/chunk_60.o(.bss);
        build/langimg/src/langimg/chunk_61.o(.bss);
        build/langimg/src/langimg/chunk_62.o(.bss);
        build/langimg/src/langimg/chunk_63.o(.bss);
        build/langimg/src/langimg/chunk_64.o(.bss);
        build/langimg/src/langimg/chunk_65.o(.bss);
        build/langimg/src/langimg/chunk_66.o(.bss);
        build/langimg/src/langimg/chunk_67.o(.bss);
        build/langimg/src/langimg/chunk_68.o(.bss);
        build/langimg/src/langimg/chunk_69.o(.bss);
        build/langimg/src/langimg/chunk_70.o(.bss);
        build/langimg/src/langimg/chunk_71.o(.bss);
        build/langimg/src/langimg/chunk_72.o(.bss);
        build/langimg/src/langimg/chunk_73.o(.bss);
        build/langimg/src/langimg/chunk_74.o(.bss);
        build/langimg/lib/psyq/langimg/lib_00.o(.bss);
        build/langimg/lib/psyq/langimg/lib_01.o(.bss);
        build/langimg/lib/psyq/langimg/lib_02.o(.bss);
        build/langimg/lib/psyq/langimg/lib_03.o(.bss);
        build/langimg/lib/psyq/langimg/lib_04.o(.bss);
        build/langimg/lib/psyq/langimg/lib_05.o(.bss);
        build/langimg/lib/psyq/langimg/lib_06.o(.bss);
        build/langimg/lib/psyq/langimg/lib_07.o(.bss);
        build/langimg/asm/langimg/data/bss.bss.o(.bss);
        main_BSS_END = .;
        main_BSS_SIZE = ABSOLUTE(main_BSS_END - main_BSS_START);
    }
    __romPos += SIZEOF(.main);
    __romPos = ALIGN(__romPos, 16);
    main_ROM_END = __romPos;
    main_VRAM_END = .;

    /DISCARD/ :
    {
        *(*);
    }
}
